## conf/layer.conf
```bitbake
# We have a conf and classes directory, add to BBPATH
BBPATH .= ":${LAYERDIR}"

# We have recipes-* directories, add to BBFILES
BBFILES += "${LAYERDIR}/recipes-*/*/*.bb \
            ${LAYERDIR}/recipes-*/*/*.bbappend"

BBFILE_COLLECTIONS += "john"
BBFILE_PATTERN_john = "^${LAYERDIR}/"
BBFILE_PRIORITY_john = "6"

LAYERDEPENDS_john = "core raspberrypi"
LAYERSERIES_COMPAT_john = "scarthgap"
```

## wic/nvme-raspberrypi.wks
```
# Raspberry Pi 5 NVMe image
# Same layout as sdimage-raspberrypi.wks but targeting nvme0n1

part /boot --source bootimg-partition --ondisk nvme0n1 --fstype=vfat --label boot --active --align 4096 --size 100
part / --source rootfs --ondisk nvme0n1 --fstype=ext4 --label root --align 4096
```

## wic/rauc-raspberrypi-tryboot.wks
```
# RAUC A/B via Raspberry Pi 5 firmware tryboot — NVMe (nvme0n1), GPT
#
# No U-Boot: the RPi firmware boots the kernel directly and we switch slots with
# the firmware's native tryboot mechanism. See system.conf (bootloader=custom)
# and tryboot-backend.sh.
#
#   p1 bootsel   FAT   64M  — holds autoboot.txt only; STABLE selector partition,
#                             never written by RAUC. autoboot.txt's [all]/[tryboot]
#                             sections set boot_partition to 2 (slot A) or 3 (slot B).
#   p2 boot-a    FAT  256M  — slot A boot files (kernel, dtbs, overlays, config.txt,
#                             cmdline-rootfs-A.txt, cmdline-rootfs-B.txt)
#   p3 boot-b    FAT  256M  — slot B boot files (empty at flash; RAUC writes on OTA)
#   p4 rootfs-a  ext4   4G  — RAUC rootfs slot A (active after initial flash)
#   p5 rootfs-b  ext4   4G  — RAUC rootfs slot B (empty at flash; OTA target)
#   p6 data      ext4 512M  — placeholder; resize-data.service expands to fill drive
#
# config.txt (identical in p2 and p3) uses the firmware's per-partition conditional:
#   [boot_partition=2] cmdline=cmdline-rootfs-A.txt   (root=/dev/nvme0n1p4)
#   [boot_partition=3] cmdline=cmdline-rootfs-B.txt   (root=/dev/nvme0n1p5)
# so the same boot image works in either slot — tryboot picks the partition,
# the conditional picks the matching rootfs.

bootloader --ptable gpt

part --ondisk nvme0n1 --fstype=vfat --label bootsel --align 4096 --fixed-size 64M
part --source bootimg-partition --ondisk nvme0n1 --fstype=vfat --label boot-a --align 4096 --fixed-size 256M
part --ondisk nvme0n1 --fstype=vfat --label boot-b --align 4096 --fixed-size 256M
part / --source rootfs --ondisk nvme0n1 --fstype=ext4 --label rootfs-a --align 4096 --fixed-size 4096M
part --ondisk nvme0n1 --fstype=ext4 --label rootfs-b --align 4096 --fixed-size 4096M
part --ondisk nvme0n1 --fstype=ext4 --label data --align 4096 --fixed-size 512M
```

## wic/rauc-raspberrypi.wks
```
# RAUC A/B partition layout — Raspberry Pi 5, NVMe (nvme0n1)
#
# Flash this image directly to /dev/nvme0n1 from the SD bootstrap image.
#
# p1  FAT32   256 MB   boot      — U-Boot + kernel + dtb
# p2  ext4      4 GB   rootfs-a  — RAUC slot A (active after initial flash)
# p3  ext4      4 GB   rootfs-b  — RAUC slot B (cloned from A; target of first OTA)
# p4  ext4    512 MB   data      — placeholder; resize-data.service expands to fill
#                                  the drive on first boot (parted + resize2fs)

part /boot --source bootimg-partition --ondisk nvme0n1 --fstype=vfat --label boot --active --align 4096 --size 256

part / --source rootfs --ondisk nvme0n1 --fstype=ext4 --label rootfs-a --align 4096 --fixed-size 4096M

part --ondisk nvme0n1 --fstype=ext4 --label rootfs-b --align 4096 --fixed-size 4096M

part /data --ondisk nvme0n1 --fstype=ext4 --label data --align 4096 --fixed-size 512M
```
